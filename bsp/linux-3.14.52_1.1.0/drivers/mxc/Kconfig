## bsp/linux-3.14.52_1.1.0/drivers/mxc/Kconfig
```kconfig
# drivers/mxc/Kconfig

if ARCH_MXC

menu "MXC support drivers"

config MXC_IPU
	bool "Image Processing Unit Driver"
	select MXC_IPU_V3
	help
	  If you plan to use the Image Processing unit, say
	  Y here. IPU is needed by Framebuffer and V4L2 drivers.

source "drivers/mxc/ipu3/Kconfig"
source "drivers/mxc/vpu/Kconfig"
source "drivers/mxc/hdmi-cec/Kconfig"
source "drivers/mxc/mipi/Kconfig"
source "drivers/mxc/mlb/Kconfig"
source "drivers/mxc/sim/Kconfig"

config MXC_GPU_VIV
    depends on SOC_IMX6Q
    tristate "MXC Vivante GPU support"
    ---help---
     Say Y to get the GPU driver support.

choice
    depends on MXC_GPU_VIV
    bool "GPU Driver version"
    default MXC_GPU_VIV_3_14_52

    help
    Select the GPU driver version that matches your userland libraries

config MXC_GPU_VIV_3_14_52
    bool "v3.14.52"

config MXC_GPU_VIV_3_14_26
    bool "v3.14.26"

endchoice


endmenu

endif
```
